## main/Kconfig.projbuild
```kconfig
menu "Configuração do Wifi"

    config ESP_WIFI_SSID
        string "WiFi SSID"
        default "ssid"
        help
            Nome da rede Wifi.
    
    config ESP_WIFI_PASSWORD
        string "Senha do Wifi"
        default "minha_senha"
        help
            Senha do WiFi (WPA or WPA2)
    
    config ESP_MAXIMUM_RETRY
        int "Número máximo de tentativas de conexão"
        default 5
        help
            Configure o valor máximo de tentativas de conexão
endmenu

menu "Low Power Mode"

    config ESP_LOW_POWER
        int "Modo Low Power (1 - Ligado / 0 - Desligado)"
        default 0
        help
            Para ativar o modo Low Power digite 1.

endmenu
```
